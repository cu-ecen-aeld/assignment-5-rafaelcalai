## base_external/package/aesd-server/Config.in
```kconfig
config BR2_PACKAGE_AESD_SERVER
	bool "aesd-server"
	help
	  Includes the aesd server in the kernel image.
	  Used to understand buildroot external trees and package builds.
```
